## conf/distro/poky-wsgui.conf
```bitbake
require conf/distro/poky.conf

DISTRO = "poky-wsgui"
DISTRO_NAME = "WeatherStationGUI Image"
DISTRO_VERSION = "V1.0.0"

# needed for eglfs to work with Qt
DISTRO_FEATURES:remove = "x11 wayland vulkan"

INIT_MANAGER = "systemd"
```

## conf/layer.conf
```bitbake
# We have a conf and classes directory, add to BBPATH
BBPATH .= ":${LAYERDIR}"

# We have recipes-* directories, add to BBFILES
BBFILES += "${LAYERDIR}/recipes-*/*/*.bb \
            ${LAYERDIR}/recipes-*/*/*.bbappend"

BBFILE_COLLECTIONS += "meta-wsgui"
BBFILE_PATTERN_meta-wsgui = "^${LAYERDIR}/"
BBFILE_PRIORITY_meta-wsgui = "6"

LAYERDEPENDS_meta-wsgui = "core"
LAYERSERIES_COMPAT_meta-wsgui = "scarthgap"
```
